## boards/phytec/distancer/Kconfig.distancer
```kconfig
# PHYTEC distancer board configuration

# Copyright (c) 2020 PHYTEC Messtechnik GmbH
# SPDX-License-Identifier: Apache-2.0

config BOARD_DISTANCER
	select SOC_NRF52832_CIAA
```

## boards/phytec/distancer/board.yml
```yaml
board:
  name: distancer
  full_name: PHYTEC distancer (rev 3)
  vendor: phytec
  socs:
    - name: nrf52832
```
